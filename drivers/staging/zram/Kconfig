## drivers/staging/zram/Kconfig
```kconfig
config ZRAM
	tristate "Compressed RAM block device support"
	depends on BLOCK && SYSFS && ZSMALLOC
	default n
	help
	  Creates virtual block devices called /dev/zramX (X = 0, 1, ...).
	  Pages written to these disks are compressed and stored in memory
	  itself. These disks allow very fast I/O and compression provides
	  good amounts of memory savings.

	  It has several use cases, for example: /tmp storage, use as swap
	  disks and maybe many more.

	  See zram.txt for more information.
	  Project home: <https://compcache.googlecode.com/>

config ZRAM_DEBUG
	bool "Compressed RAM block device debug support"
	depends on ZRAM
	default n
	help
	  This option adds additional debugging code to the compressed
	  RAM block device driver.

choice ZRAM_COMPRESS_ALGORITHM
	prompt "ZRAM algorithm"
	depends on ZRAM
	default ZRAM_LZ4
	help
		Select the compression method used by zram.

config ZRAM_LZO
	bool "LZO Compression"
	select LZO_COMPRESS
	select LZO_DECOMPRESS

config ZRAM_LZ4
	bool "LZ4 Compression"
	select LZ4_COMPRESS
	select LZ4_DECOMPRESS
endchoice
```
